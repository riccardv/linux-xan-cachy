## kernel/Kconfig.hz
```kconfig
# SPDX-License-Identifier: GPL-2.0-only
#
# Timer Interrupt Frequency Configuration
#

#
# Silent symbols keep CONFIG_HZ_* available to the rest of the tree and to
# inherited .configs, but they are not choice members. The promptable
# *_NODEF names are what olddefconfig can stick on; renaming every rate
# (including 100) means a saved "# CONFIG_HZ_100 is not set" cannot pin the
# choice away from the MuQSS default.
#
config HZ_100
	bool

config HZ_250
	bool

config HZ_300
	bool

config HZ_1000
	bool

choice
	prompt "Timer frequency"
	default HZ_100_NODEF if SCHED_MUQSS
	default HZ_250_NODEF if !SCHED_MUQSS
	help
	 Allows the configuration of the timer frequency. It is customary
	 to have the timer interrupt run at 1000 Hz but 100 Hz may be more
	 beneficial for servers and NUMA systems that do not need to have
	 a fast response for user interaction and that may experience bus
	 contention and cacheline bounces as a result of timer interrupts.
	 Note that the timer interrupt occurs on each processor in an SMP
	 environment leading to NR_CPUS * HZ number of timer interrupts
	 per second.


	config HZ_100_NODEF
		bool "100 HZ"
		select HZ_100
	help
	  100 Hz is a suitable choice in combination with MuQSS which does
	  not rely on ticks for rescheduling interrupts, and is not Hz limited
	  for timeouts and sleeps from both the kernel and userspace.
	  This allows us to benefit from the lower overhead and higher
	  throughput of fewer timer ticks.

	  Non-MuQSS kernels:
	  100 Hz is a typical choice for servers, SMP and NUMA systems
	  with lots of processors that may show reduced performance if
	  too many timer interrupts are occurring.

	config HZ_250_NODEF
		bool "250 HZ"
		select HZ_250
	help
	 250 Hz is a good compromise choice allowing server performance
	 while also showing good interactive responsiveness even
	 on SMP and NUMA systems. If you are going to be using NTSC video
	 or multimedia, select 300Hz instead.

	 250 Hz is the default choice for the mainline scheduler but not
	 advantageous in combination with MuQSS.

	config HZ_300_NODEF
		bool "300 HZ"
		select HZ_300
	help
	 300 Hz is a good compromise choice allowing server performance
	 while also showing good interactive responsiveness even
	 on SMP and NUMA systems and exactly dividing by both PAL and
	 NTSC frame rates for video and multimedia work.

	config HZ_1000_NODEF
		bool "1000 HZ"
		select HZ_1000
	help
	 1000 Hz is the preferred choice for desktop systems and other
	 systems requiring fast interactive responses to events.

endchoice

config HZ
	int
	default 100 if HZ_100
	default 250 if HZ_250
	default 300 if HZ_300
	default 1000 if HZ_1000

config SCHED_HRTICK
	def_bool HIGH_RES_TIMERS
```
